## Config.in
```kconfig
menu "PhantoWD packages"

source "$BR2_EXTERNAL_PHANTOWD_EX4_PATH/package/phantowd-api/Config.in"
source "$BR2_EXTERNAL_PHANTOWD_EX4_PATH/package/phantowd-volume-probe/Config.in"

endmenu
```

## configs/phantowd_ex4_stage_b3_defconfig
```kconfig
BR2_arm=y
BR2_arm926t=y
BR2_ARM_EABI=y
BR2_ARM_SOFT_FLOAT=y
BR2_PACKAGE_HOST_LINUX_HEADERS_CUSTOM_6_12=y
BR2_GLOBAL_PATCH_DIR="$(BR2_EXTERNAL_PHANTOWD_EX4_PATH)/board/qemu/armv5/patches"
BR2_DOWNLOAD_FORCE_CHECK_HASHES=y
BR2_REPRODUCIBLE=y
BR2_TARGET_GENERIC_HOSTNAME="phantowd-ex4-stage-b3"
BR2_TARGET_GENERIC_ISSUE="PhantoWD EX4 Stage B3 combined network and sensor probe"
BR2_INIT_NONE=y
BR2_PACKAGE_BUSYBOX_CONFIG="$(BR2_EXTERNAL_PHANTOWD_EX4_PATH)/board/wd/ex4/stage-a/busybox.config"
BR2_PACKAGE_BUSYBOX_CONFIG_FRAGMENT_FILES="$(BR2_EXTERNAL_PHANTOWD_EX4_PATH)/board/wd/ex4/stage-b3/busybox.fragment"
BR2_ROOTFS_OVERLAY="$(BR2_EXTERNAL_PHANTOWD_EX4_PATH)/board/wd/ex4/stage-b3/rootfs-overlay"
BR2_ROOTFS_POST_BUILD_SCRIPT="$(BR2_EXTERNAL_PHANTOWD_EX4_PATH)/board/wd/ex4/stage-a/post-build.sh"
BR2_ROOTFS_POST_FAKEROOT_SCRIPT="$(BR2_EXTERNAL_PHANTOWD_EX4_PATH)/board/wd/ex4/stage-a/post-build.sh"
BR2_LINUX_KERNEL=y
BR2_LINUX_KERNEL_CUSTOM_VERSION=y
BR2_LINUX_KERNEL_CUSTOM_VERSION_VALUE="6.18.53"
BR2_LINUX_KERNEL_NEEDS_HOST_OPENSSL=y
BR2_LINUX_KERNEL_DEFCONFIG="multi_v5"
BR2_LINUX_KERNEL_CONFIG_FRAGMENT_FILES="$(BR2_EXTERNAL_PHANTOWD_EX4_PATH)/board/wd/ex4/stage-a/linux.fragment $(BR2_EXTERNAL_PHANTOWD_EX4_PATH)/board/wd/ex4/stage-b/linux.fragment $(BR2_EXTERNAL_PHANTOWD_EX4_PATH)/board/wd/ex4/stage-b2/linux.fragment $(BR2_EXTERNAL_PHANTOWD_EX4_PATH)/board/wd/ex4/stage-b3/linux.fragment"
BR2_LINUX_KERNEL_DTS_SUPPORT=y
BR2_LINUX_KERNEL_CUSTOM_DTS_PATH="$(BR2_EXTERNAL_PHANTOWD_EX4_PATH)/board/wd/ex4/stage-b3/kirkwood-wd-mycloud-ex4-stage-b3.dts"
BR2_LINUX_KERNEL_ZIMAGE=y
BR2_TARGET_ROOTFS_INITRAMFS=y
BR2_PACKAGE_HOST_UBOOT_TOOLS=y
# BR2_TARGET_ROOTFS_TAR is not set
```

## configs/phantowd_qemu_armv5_defconfig
```kconfig
BR2_arm=y
BR2_arm926t=y
BR2_ARM_EABI=y
BR2_ARM_SOFT_FLOAT=y
BR2_PACKAGE_HOST_LINUX_HEADERS_CUSTOM_6_12=y
BR2_GLOBAL_PATCH_DIR="$(BR2_EXTERNAL_PHANTOWD_EX4_PATH)/board/qemu/armv5/patches"
BR2_DOWNLOAD_FORCE_CHECK_HASHES=y
BR2_REPRODUCIBLE=y
BR2_CCACHE=y
BR2_CCACHE_INITIAL_SETUP="--max-size=1G"
BR2_TARGET_GENERIC_HOSTNAME="phantowd-qemu-armv5"
BR2_TARGET_GENERIC_ISSUE="PhantoWD ARMv5 QEMU development image"
BR2_TARGET_GENERIC_GETTY_PORT="ttyAMA0"
BR2_SYSTEM_DHCP="eth0"
BR2_PACKAGE_PHANTOWD_API=y
BR2_PACKAGE_PHANTOWD_API_QEMU_SELFTEST=y
BR2_PACKAGE_NFS_UTILS=y
BR2_PACKAGE_SAMBA4=y
BR2_PACKAGE_HOST_GO_BIN=y
BR2_ROOTFS_OVERLAY="$(BR2_EXTERNAL_PHANTOWD_EX4_PATH)/board/qemu/armv5/rootfs-overlay"
BR2_ROOTFS_POST_IMAGE_SCRIPT="board/qemu/post-image.sh"
BR2_ROOTFS_POST_SCRIPT_ARGS="$(BR2_DEFCONFIG)"
BR2_LINUX_KERNEL=y
BR2_LINUX_KERNEL_CUSTOM_VERSION=y
BR2_LINUX_KERNEL_CUSTOM_VERSION_VALUE="6.18.53"
BR2_LINUX_KERNEL_DEFCONFIG="versatile"
BR2_LINUX_KERNEL_CONFIG_FRAGMENT_FILES="board/qemu/arm-versatile/linux.fragment $(BR2_EXTERNAL_PHANTOWD_EX4_PATH)/board/qemu/armv5/linux-nfs.fragment $(BR2_EXTERNAL_PHANTOWD_EX4_PATH)/board/qemu/armv5/linux-qemu-rng.fragment"
BR2_LINUX_KERNEL_DTS_SUPPORT=y
BR2_LINUX_KERNEL_INTREE_DTS_NAME="arm/versatile-pb"
BR2_TARGET_ROOTFS_EXT2=y
BR2_TARGET_ROOTFS_EXT2_SIZE="80M"
BR2_TARGET_ROOTFS_EXT2_MKFS_OPTIONS="-O ^64bit -U f528951a-1e1d-5515-b6c1-bb3a24868832 -E hash_seed=2f6ef28f-3b9f-50df-921c-00f4b01ca898"
# BR2_TARGET_ROOTFS_TAR is not set
```

## configs/phantowd_rc0_armv5_defconfig
```kconfig
BR2_arm=y
BR2_arm926t=y
BR2_ARM_EABI=y
BR2_ARM_SOFT_FLOAT=y
BR2_TOOLCHAIN_BUILDROOT_GLIBC=y
BR2_PACKAGE_HOST_LINUX_HEADERS_CUSTOM_6_12=y
BR2_GLOBAL_PATCH_DIR="$(BR2_EXTERNAL_PHANTOWD_EX4_PATH)/board/qemu/armv5/patches"
BR2_DOWNLOAD_FORCE_CHECK_HASHES=y
BR2_REPRODUCIBLE=y
BR2_TARGET_GENERIC_HOSTNAME="phantowd-rc0"
BR2_TARGET_GENERIC_ISSUE="PhantoWD RC0 research image"
BR2_TARGET_GENERIC_GETTY_PORT="ttyAMA0"
# BR2_TARGET_ENABLE_ROOT_LOGIN is not set
BR2_PACKAGE_PHANTOWD_API=y
# BR2_PACKAGE_PHANTOWD_API_QEMU_SELFTEST is not set
BR2_PACKAGE_HOST_GO_BIN=y
BR2_ROOTFS_OVERLAY="$(BR2_EXTERNAL_PHANTOWD_EX4_PATH)/board/rc0/rootfs-overlay"
BR2_LINUX_KERNEL=y
BR2_LINUX_KERNEL_CUSTOM_VERSION=y
BR2_LINUX_KERNEL_CUSTOM_VERSION_VALUE="6.18.55"
BR2_LINUX_KERNEL_DEFCONFIG="versatile"
BR2_LINUX_KERNEL_CONFIG_FRAGMENT_FILES="board/qemu/arm-versatile/linux.fragment"
BR2_LINUX_KERNEL_DTS_SUPPORT=y
BR2_LINUX_KERNEL_INTREE_DTS_NAME="arm/versatile-pb"
BR2_TARGET_ROOTFS_EXT2=y
BR2_TARGET_ROOTFS_EXT2_SIZE="40M"
BR2_TARGET_ROOTFS_EXT2_MKFS_OPTIONS="-O ^64bit -U d985cfa0-6623-47c2-ab1e-270a355d1a29 -E hash_seed=cf35c3cf-c141-46d1-8b20-e2797c6e3245"
# BR2_TARGET_ROOTFS_TAR is not set
```

## package/phantowd-api/Config.in
```kconfig
config BR2_PACKAGE_PHANTOWD_API
	bool "phantowd-api (management API)"
	depends on BR2_PACKAGE_HOST_GO_TARGET_ARCH_SUPPORTS
	select BR2_PACKAGE_HOST_GO
	select BR2_PACKAGE_PHANTOWD_CODE_HASH if BR2_ARM_CPU_ARMV5
	help
	  Go management API and embedded dashboard. The QEMU self-test option
	  installs the development init services and storage-device rules.
	  Normal builds provide the binary; the selected product profile
	  supplies its service startup configuration.

config BR2_PACKAGE_PHANTOWD_API_QEMU_SELFTEST
	bool "QEMU-only self-test harness (never for product images)"
	depends on BR2_PACKAGE_PHANTOWD_API
	default n
	help
	  Compile the guest-only end-to-end smoke harness, including a disposable
	  test credential. Enable only in the QEMU development defconfig. Production
	  firmware builds must leave this disabled.
```

## package/phantowd-code-hash/Config.in
```kconfig
# SPDX-License-Identifier: Apache-2.0
# SPDX-FileCopyrightText: 2026 PhantoWD EX4 contributors
config BR2_PACKAGE_PHANTOWD_CODE_HASH
	bool "phantowd-code-hash"
	depends on BR2_ARM_CPU_ARMV5
	select BR2_PACKAGE_NETTLE
	help
	  Fixed read-only hash worker using inherited descriptors.
	  Uses configured generic C Nettle routines on ARMv5.
	  Reserves a service identity; never activates a service.
```

## package/phantowd-volume-probe/Config.in
```kconfig
config BR2_PACKAGE_PHANTOWD_VOLUME_PROBE
	bool "phantowd-volume-probe (read-only descriptor metadata)"
	depends on BR2_USE_MMU
	select BR2_PACKAGE_UTIL_LINUX
	select BR2_PACKAGE_UTIL_LINUX_LIBBLKID
	help
	  Small libblkid-based helper reading one caller-supplied read-only file
	  descriptor. No device enumeration, mount, repair or activation interface.
	  Initial qualification is restricted to disposable images and QEMU.
```
